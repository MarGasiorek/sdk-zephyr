/*
 * Copyright (c) 2024 Nordic Semiconductor
 *
 * SPDX-License-Identifier: Apache-2.0
 */
#include "nrf54h20dk_nrf54h20_common.dtsi"

&spi130 {
	memory-regions = <&cpuapp_dma_region>;

	ethernet: eth_spi@0 {
		compatible = "wiznet,w5500";
	};
// ethernet: eth_spi@0 {
	// 	compatible = "microchip,enc28j60";
	// 	full-duplex;
	// };
};
